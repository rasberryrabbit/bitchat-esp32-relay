## sdkconfig.defaults.esp32s3
```kconfig
# sdkconfig.defaults.esp32s3 - ESP32-S3 Super Mini (v42: ECDSA, no PSRAM)
# v42: S3 지원 복구 — ECDSA P-256 전환으로 mbedTLS 안정화

# ==== 결정적 플래시 설정 ====
CONFIG_ESPTOOLPY_FLASHMODE_DIO=y
CONFIG_ESPTOOLPY_FLASHFREQ_40M=y
CONFIG_ESPTOOLPY_FLASHSIZE_4MB=y
CONFIG_ESPTOOLPY_FLASHSIZE="4MB"

# ==== USB CDC ====
CONFIG_TINYUSB_CDC_ENABLED=y

# ==== PSRAM 비활성 (mbedTLS 안정성) ====
CONFIG_SPIRAM=n
CONFIG_SPIRAM_USE_MALLOC=n

# ==== CPU/클럭 ====
CONFIG_ESP32S3_DEFAULT_CPU_FREQ_160=y
CONFIG_ESP32S3_DEFAULT_CPU_FREQ_MHZ=160

# ==== BLE ====
CONFIG_BT_ENABLED=y
CONFIG_BT_NIMBLE_ENABLED=n
CONFIG_BT_BLUEDROID_ENABLED=n
CONFIG_BTDM_CONTROLLER_MODE_BTDM=y

# ==== NVS ====
CONFIG_NVS_FLASH_ENABLED=y

# ==== FreeRTOS ====
CONFIG_FREERTOS_HZ=1000

# ==== 로깅 ====
CONFIG_LOG_DEFAULT_LEVEL_INFO=y
CONFIG_LOG_MAXIMUM_LEVEL_VERBOSE=y

# ==== mbedtls - v42: ECDSA P-256 (RSA 제거, CTR_DRBG 우회) ====
CONFIG_MBEDTLS_HARDWARE_AES=y
CONFIG_MBEDTLS_HARDWARE_MPI=y
CONFIG_MBEDTLS_HARDWARE_SHA=y
CONFIG_MBEDTLS_EDDSA_C=y
CONFIG_MBEDTLS_SHA512_C=y
CONFIG_MBEDTLS_ENTROPY_C=y
CONFIG_MBEDTLS_CTR_DRBG_C=y
CONFIG_MBEDTLS_ECP_C=y
CONFIG_MBEDTLS_ECDSA_C=y
CONFIG_MBEDTLS_RSA_C=n
CONFIG_MBEDTLS_X509_CRT_WRITE_C=y
CONFIG_MBEDTLS_PEM_WRITE_C=y

# ==== WiFi ====
CONFIG_ESP_WIFI_ENABLED=y

# ==== Partition Table ====
CONFIG_PARTITION_TABLE_DEFAULT=y

# ==== Arduino ====
CONFIG_AUTOSTART_ARDUINO=y

# ==== 전원 관리 ====
CONFIG_PM_ENABLE=y
CONFIG_PM_DFS_INIT_AUTO=y
CONFIG_PM_POWER_DOWN_CPU=n
CONFIG_FREERTOS_USE_TICKLESS_IDLE=n
CONFIG_FREERTOS_USE_RTC_HWOPTS=n
CONFIG_UART_ISR_IN_IRAM=y
CONFIG_ESP_BROWNOUT_DET=y
CONFIG_ESP_BROWNOUT_DET_LVL=7
```
